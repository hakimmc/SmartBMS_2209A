VERSION ""

NS_ :

BS_:

BU_: SMARTBMS

BO_ 259 Battery_Temperatures: 8 Vector__XXX

BO_ 258 Battery_Voltages: 8 Vector__XXX

BO_ 257 Battery_Messages: 8 Vector__XXX
 SG_ BatteryChemistry : 3|5@1+ (1,0) [0|31] "" BatteryChemistryValues
 SG_ AliveCounter : 0|3@1+ (1,0) [0|0] "" Vector__XXX

BO_ 256 Can_Main: 8 Vector__XXX

BA_DEF_  "BusType" STRING ;
BA_DEF_DEF_  "BusType" "CAN";
